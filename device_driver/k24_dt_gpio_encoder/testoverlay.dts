
/dts-v1/;
/plugin/;
/ {
	compatible = "brcm,bcm2835";
	fragment@0 {
		target-path = "/";
		__overlay__ {
			foo_device {
				compatible = "packt,gpio-descriptor-sample";
				led-gpios = <&gpio 20 0>,
							<&gpio 21 0>;

				btn1-gpios = <&gpio 12 1>;
				btn2-gpios = <&gpio 16 1>;
			};
		};
	};
};
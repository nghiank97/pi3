/dts-v1/;
/plugin/;
/ {
    compatible = "brcm,bcm2835";
    fragment@0 {
        target = <&spidev0>;
        __overlay__ {
            status = "disabled";
            tft_a0 = <&gpio 25 1>; 
            tft_rst = <&gpio 7 1>; 
        };
    };
};
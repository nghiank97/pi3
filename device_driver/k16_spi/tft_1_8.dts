
/dts-v1/;
/plugin/;

/ {
    compatible = "brcm,bcm2835";

    fragment@0 {
        target = <&spidev0>;

        __overlay__ {
            compatible = "spi,tft_1_8";
            cs-gpios = <&gpio 8 1>;
			spi-max-frequency = <12000000>;
			spi-bits-per-word = <8>;
			status = "okay"; 
        };
    };
};